## app/gimbal/Kconfig
```kconfig
config EXAMPLES_GIMBAL
	bool "K7 UART6 STM32 gimbal command"
	default n
	depends on RK3576_UART6 && BUILD_FLAT
```

## app/k7arena/Kconfig
```kconfig
config EXAMPLES_K7ARENA
	tristate "K7 bounded ggml model arena diagnostic"
	depends on EXAMPLES_K7GRAPH && CXX_EXCEPTION
	default n
```

## app/k7audio/Kconfig
```kconfig
config EXAMPLES_K7AUDIO
	bool "K7 read-only audio clock preflight"
	depends on ARCH_BOARD_KICKPI_K7 && RK3576_USB_DIAG && BUILD_FLAT
	default n
	---help---
		Explicit command reads CRU/IOC fields only. No I2C transactions,
		codec initialization, sound, DMA, pinmux writes or clock changes.
```

## app/k7audiohw/Kconfig
```kconfig
config EXAMPLES_K7AUDIOHW
	bool "KICKPI K7 bounded native audio bring-up"
	default n
	depends on ARCH_BOARD_KICKPI_K7
```

## app/k7cxx/Kconfig
```kconfig
config EXAMPLES_K7CXX
	tristate "K7 native C++ runtime prerequisite probe"
	depends on HAVE_CXX && LIBCXX && CXX_EXCEPTION && CXX_RTTI
	default n
```

## app/k7ehcontrol/Kconfig
```kconfig
config EXAMPLES_K7EHCONTROL
	tristate "K7 two-worker exception diagnostic"
	depends on SMP && HAVE_CXX && LIBCXX && CXX_EXCEPTION && CXX_RTTI
	default n
```

## app/k7emmc/Kconfig
```kconfig
config EXAMPLES_K7EMMC
	bool "K7 bounded eMMC read-only diagnostic"
	depends on ARCH_BOARD_KICKPI_K7 && BUILD_FLAT
	default n
```

## app/k7fat/Kconfig
```kconfig
config EXAMPLES_K7FAT
	tristate "K7 explicit read-only FAT diagnostic"
	depends on FS_FAT && FAT_FORCE_READONLY && FAT_FORCE_INDIRECT && USBHOST_MSC_READONLY
	default n
```

## app/k7graph/Kconfig
```kconfig
config EXAMPLES_K7GRAPH
	tristate "K7 real ggml CPU graph diagnostic"
	depends on SMP && HAVE_CXX && LIBCXX && CXX_EXCEPTION
	default n
```

## app/k7host/Kconfig
```kconfig
config EXAMPLES_K7HOST
	bool "K7 USB host enumeration command"
	depends on RK3576_USBHOST

config EXAMPLES_K7HOST_JPEG
	bool "K7 retained camera JPEG decode diagnostic"
	depends on EXAMPLES_K7HOST
	select LIB_JPEG_TURBO

config EXAMPLES_K7HOST_YUNET
	bool "K7 fixed YuNet CPU face detection diagnostic"
	depends on EXAMPLES_K7HOST_JPEG
	help
		Run hash-pinned YuNet FP32 weights on RGB160 camera frames.
		Requires about 7 MB of CPU scratch memory; no NPU acceleration.

config EXAMPLES_K7HOST_TRACK
	bool "K7 bounded face-to-gimbal tracking"
	depends on EXAMPLES_K7HOST_YUNET && EXAMPLES_GIMBAL
	help
		Explicit dry/run command with MCU target-unit limits and loss hold.
		Shares exclusive UART ownership with manual gimbal commands.
```

## app/k7load/Kconfig
```kconfig
config EXAMPLES_K7LOAD
	tristate "K7 bounded A72 compute and radio coexistence diagnostic"
	depends on RK3576_SMP_DIAG && SMP && SMP_NCPUS = 8
	default n
```

## app/k7mem/Kconfig
```kconfig
config EXAMPLES_K7MEM
	bool "K7 isolated model DDR arena test"
	depends on RK3576_MODEL_ARENA
	default n
```

## app/k7neon/Kconfig
```kconfig
config EXAMPLES_K7NEON
	tristate "K7 bounded A72 SIMD context diagnostic"
	depends on RK3576_SMP_DIAG && SMP && SMP_NCPUS = 8 && ARM64_NEON
	default n
```

## app/k7npu/Kconfig
```kconfig
config EXAMPLES_K7NPU
	bool "K7 NPU read-only prerequisite diagnostics"
	default n
	depends on ARCH_BOARD_KICKPI_K7 && RK3576_NPU_DIAG && BUILD_FLAT
	---help---
		Read fixed PMU/CRU status registers using the existing K7 mappings.
		Does not initialize the NPU or perform inference.

config K7NPU_MMU_TEST
	bool "K7 idle NPU MMU paging lifecycle test"
	depends on EXAMPLES_K7NPU
	default n
	---help---
		Experimental mmutest command using private static page tables.
		Changes idle MMU directory/paging registers and restores them.
		Never submits NPU tasks; use only in isolated RAM bring-up.

config K7NPU_RAW_TEST
	bool "K7 experimental one-shot NPU matrix (GPL fixture)"
	depends on K7NPU_MMU_TEST
	default n
	---help---
		Submits one fixed 1x64x64 INT8 raw task on core0. Includes a
		GPL-2.0-or-later fixture generated from pinned charsiu source.
		Uses only private static buffers; requires RAM reboot after use.
		Not a model runtime; keep this experiment out of production builds.
```

## app/k7smp/Kconfig
```kconfig
config EXAMPLES_K7SMP
	tristate "K7 bounded two-A53 diagnostic"
	depends on RK3576_SMP_DIAG && SMP
	default n
```

## app/k7usb/Kconfig
```kconfig
config EXAMPLES_K7USB
	bool "K7 USB-A diagnostic command"
	default n
	depends on RK3576_USB_DIAG && BUILD_FLAT
```

## evidence/cloud-radio-build-20260914/sdk-before/app/k7agent/Kconfig
```kconfig
# Agent components remain disabled until their runtime gates pass.

config EXAMPLES_K7CLOUD
	bool "K7 bounded DNS and HTTPS connectivity probe"
	depends on ARCH_BOARD_KICKPI_K7 && BUILD_FLAT
	depends on EXAMPLES_K7RADIO_IP && NET_TCP && NET_SOCKOPTS
	depends on NETDB_DNSCLIENT && CRYPTO_MBEDTLS
	default n
	---help---
		Links the reviewed bounded DNS and HTTPS clients into an explicit
		diagnostic command. HTTPS still refuses to start until the platform
		provides approved entropy, trusted wall time and a caller-owned CA.

config EXAMPLES_K7CLOUD_MIMO_V25
	bool "Compile bounded MiMo v2.5 ASR/TTS protocol support"
	depends on EXAMPLES_K7CLOUD
	default n
	---help---
		Compiles the reviewed non-streaming MiMo v2.5 Chat Completions
		ASR/TTS encoders and strict response decoders. This option does not
		store a token, choose a Token Plan region, or initiate a request.

config EXAMPLES_K7CLOUD_SPEECH_ORCHESTRATOR
	bool "Compile gated MiMo speech orchestration with K7 audio"
	depends on EXAMPLES_K7CLOUD_MIMO_V25 && EXAMPLES_K7SOUND
	default n
	---help---
		Compiles the batch cloud speech coordinator. Cloud ASR/TTS stays
		disabled until live Wi-Fi, IPv4, DNS, entropy, trusted time, CA,
		TCP and API checks are reported ready. The connected prompt is a
		caller-owned local 16 kHz asset and does not require the cloud.
```

## work-in-progress/parallel-https-client-sol/Kconfig
```kconfig
config VELAVISION_HTTPS_CLIENT_CANDIDATE
	bool "VelaVision bounded HTTPS client candidate"
	depends on CRYPTO_MBEDTLS && NET_TCP && NET_SOCKOPTS
	default n
	---help---
		Candidate-only HTTPS/1.1 client with mandatory peer verification,
		SNI, monotonic deadlines, cancellation, bounded framing and streaming
		request/response callbacks. DNS and application protocol are external.

if VELAVISION_HTTPS_CLIENT_CANDIDATE

config VELAVISION_HTTPS_REQUEST_HEADER_MAX
	int "Maximum generated request header bytes"
	default 4096
	range 512 16384

config VELAVISION_HTTPS_RESPONSE_HEADER_MAX
	int "Maximum response header and trailer bytes"
	default 8192
	range 512 32768

config VELAVISION_HTTPS_RESPONSE_BODY_MAX
	int "Maximum decoded response body bytes"
	default 262144
	range 1024 4194304

config VELAVISION_HTTPS_CHUNK_MAX
	int "Maximum single HTTP chunk bytes"
	default 32768
	range 256 262144

endif
```

## work-in-progress/parallel-k7-audio/sources/project/port/new/nuttx/arch/arm64/src/rk3576/Kconfig
```kconfig
#
# Rockchip RK3576 initial UART0 / single-core BSP
#

if ARCH_CHIP_RK3576

menu "Rockchip RK3576 Peripheral Selection"

config RK3576_UART0
	bool "Bootloader-initialized UART0"
	default y
	select 16550_UART
	select 16550_UART0
	select SERIAL_UART_ARCH_MMIO
	---help---
		Use DW APB UART0 at 0x2ad40000.  The initial K7 configuration
		preserves bootloader pinmux, clocks, baud divisor and FIFO setup.
		UART0 preserves the bootloader console configuration.

config RK3576_UART6
	bool "K7 UART6 M0 at fixed 115200 8N1"
	depends on ARCH_BOARD_KICKPI_K7
	select 16550_UART
	select 16550_UART1
	select SERIAL_UART_ARCH_MMIO
	---help---
		Physical UART6 is mapped to generic 16550 slot 1 (/dev/ttyS1).
		Initialize clocks, reset and GPIO4_A4/A6 pinmux explicitly.
		Requires the K7 flat-build bootloader handoff and fixed baud.

config RK3576_USB_DIAG
	bool "K7 read-only USB-A register diagnostics"
	depends on ARCH_BOARD_KICKPI_K7 && BUILD_FLAT
	default n
	---help---
		Map the USB-A DWC3 register block and PMU for the k7usb app.
		This does not initialize USB or change clocks, power, or pinmux.

config RK3576_USBHOST
	bool "K7 USB2 host bring-up"
	depends on USBHOST_RK3576_XHCI && ARCH_BOARD_KICKPI_K7 && BUILD_FLAT
	select RK3576_USB_DIAG
	default n

config RK3576_NPU_DIAG
	bool "K7 guarded read-only NPU register probe"
	depends on RK3576_USB_DIAG && ARCH_BOARD_KICKPI_K7 && BUILD_FLAT
	default n
	---help---
		Map both NPU cores and their MMU status registers for k7npu.
		Does not initialize the NPU, allocate DMA buffers or run inference.

config RK3576_MODEL_ARENA
	bool "K7 dedicated 1GiB CPU model arena (experimental)"
	depends on ARCH_BOARD_KICKPI_K7 && BUILD_FLAT
	default n
	---help---
		Maps 0x60000000..0xa0000000 as a separate explicit CPU heap.
		Never changes the primary heap or DMA allocator. Enable only
		for the audited 4GB K7 handoff; not a general DDR autodetector.

endmenu

endif # ARCH_CHIP_RK3576
```

## work-in-progress/parallel-model-reader-medium/audio-codec-live-review-v1/snapshot/app/k7sound/Kconfig
```kconfig
config EXAMPLES_K7SOUND
	bool "KICKPI K7 bounded analog capture and playback"
	default n
	depends on ARCH_BOARD_KICKPI_K7
```

## work-in-progress/parallel-model-reader-medium/voice-radio-backend-v1/input/Kconfig
```kconfig
config EXAMPLES_K7RADIO
	bool "K7 native Seekwave Wi-Fi and Bluetooth"
	depends on ARCH_BOARD_KICKPI_K7 && RK3576_USB_DIAG && BUILD_FLAT
	default n
	---help---
		Explicit-command SDMMC1 wireless firmware, native Bluetooth GATT,
		Wi-Fi scan and WPA2-PSK/CCMP authentication. No eMMC access.

config EXAMPLES_K7RADIO_IP
	bool "K7 experimental native IPv4 network endpoint"
	depends on EXAMPLES_K7RADIO && NET_ETHERNET && NET_IPv4 && NET_UDP && NETUTILS_DHCPC
	default n
	---help---
		Native Ethernet data and DHCP after WPA2 authentication. Initial
		20 MHz non-aggregated STA mode, MTU 1000, explicit startup only.
```

## work-in-progress/tts-spoken-flow-20260913/input/app/voicelink/Kconfig
```kconfig
config EXAMPLES_K7VOICE
	bool "K7 native VoiceLink integration"
	depends on EXAMPLES_K7RADIO_SHARED && HAVE_CXX && LIBCXX && CXX_EXCEPTION
	default n
	---help---
		Native network adapter and control core. ASR/TTS not integrated yet.
		Explicit probe/scan commands are integration diagnostics, not speech.

config EXAMPLES_K7VOICE_STAGED_ASSETS
	bool "Reserve upper model window for staged speech assets"
	depends on EXAMPLES_K7VOICE && RK3576_MODEL_ARENA
	default n
	---help---
		Use only the lower 512 MiB for the model heap. Keep the upper
		512 MiB mapped for explicitly verified ASR and TTS RAM resources.
```
